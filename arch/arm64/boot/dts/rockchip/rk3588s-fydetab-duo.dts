// SPDX-License-Identifier: (GPL-2.0+ OR MIT)
/*
 * Copyright (c) 2021 Rockchip Electronics Co., Ltd.
 *
 */

/dts-v1/;

#include "rk3588s-tablet-12c.dtsi"
#include "rk3588-linux.dtsi"

/ {
	model = "Fydetab Duo";
	compatible = "rockchip,rk3588s-tablet-12c-linux", "rockchip,rk3588";
};
